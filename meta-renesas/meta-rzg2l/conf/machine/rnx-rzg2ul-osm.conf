## meta-renesas/meta-rzg2l/conf/machine/rnx-rzg2ul-osm.conf
```bitbake
#@TYPE: Machine
#@NAME: rnx-rzg2ul-osm machine
#@DESCRIPTION: RZ/G2UL OSM platform

# --- Debian Buster Snapshot fallback (3 Nov 2023) ---
PREMIRRORS_prepend = "\
    https://.*/debian-security/ https://snapshot.debian.org/archive/debian-security/20231103T000000Z/ \n \
    http://.*/debian-security/ https://snapshot.debian.org/archive/debian-security/20231103T000000Z/ \n \
    https://.*/debian/ https://snapshot.debian.org/archive/debian/20231103T000000Z/ \n \
    http://.*/debian/ https://snapshot.debian.org/archive/debian/20231103T000000Z/ \n \
"

SOC_FAMILY = "r9a07g043u"
require conf/machine/include/rzg2l-common.inc
require conf/machine/include/cip-core.inc

DEFAULTTUNE ?= "cortexa55"

TUNE_CONF ?= "conf/machine/include/tune-cortexa55.inc"
require ${TUNE_CONF}

PREFERRED_PROVIDER_virtual/kernel = "linux-renesas"

UBOOT_CONFIG ??= "rnx-rzg2ul-osm"
UBOOT_CONFIG[rnx-rzg2ul-osm] = "rnx_rzg2ul_osm_defconfig"

# flash writer
EXTRA_IMAGEDEPENDS += " flash-writer"

# Supported devicetree
KERNEL_DEVICETREE = " \
	renesas/rnx-rzg2ul-osm.dtb \
"

IMAGE_BOOT_FILES = " \
	bl2_bp-${MACHINE}.srec \
	fip-${MACHINE}.srec \
	Flash_Writer_SCIF_RZG2UL_SMARC_DDR4_1GB_1PCS.mot \
	Image-rnx-rzg2ul-osm.bin \
	rnx-rzg2ul-osm.dtb \
"
```
